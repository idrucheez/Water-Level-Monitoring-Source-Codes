#include "mbed.h"
#include <cstring>
#include <cstdio>

// TANK CONFIG 
#define TANK_EMPTY_DIST_CM  18.5f
#define TANK_FULL_DIST_CM    3.0f
#define NUM_SAMPLES           5
#define PUMP_ON_THRESHOLD   90.0f
#define PUMP_OFF_THRESHOLD  90.0f
#define CRITICAL_LOW_LEVEL  10.0f
#define TANK_FULL_LEVEL     95.0f

// OLED
#define I2C_FREQ    100000
#define OLED_ADDR   0x3C
#define RESET_PIN   D4

I2C i2c(PB_9, PB_8);
DigitalOut oled_reset(RESET_PIN);

// PERIPHERALS 
DigitalOut trig(PA_0);
DigitalIn  echo(PA_1);
DigitalOut relay(PB_6);
DigitalOut buzzer(PA_6);

// UART TX/RX PINS FOR ESP32 
DigitalOut esp_tx(PA_9);       // We'll do software serial TX
// For receiving override, we'll use a simple DigitalIn approach

uint8_t buffer[512];
bool manual_override = false;
int loop_count = 0;

// 5x7 FONT 
static const uint8_t font5x7[96][5] = {
    {0x00,0x00,0x00,0x00,0x00},{0x00,0x00,0x5F,0x00,0x00},
    {0x00,0x07,0x00,0x07,0x00},{0x14,0x7F,0x14,0x7F,0x14},
    {0x24,0x2A,0x7F,0x2A,0x12},{0x23,0x13,0x08,0x64,0x62},
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    {0x10,0x08,0x08,0x10,0x08},{0x00,0x00,0x00,0x00,0x00}
};

// OLED FUNCTIONS 
void draw_char(uint8_t x, uint8_t y, char c) {
    if (c < 32 || c > 127) return;
    uint8_t idx = c - 32;
    for (int i = 0; i < 5; i++) {
        uint8_t col = font5x7[idx][i];
        for (int j = 0; j < 7; j++) {
            if (col & (1 << j)) {
                int px = x + i, py = y + j;
                if (px < 128 && py < 32)
                    buffer[(py/8)*128+px] |= (1<<(py%8));
            }
        }
    }
}
void draw_text(uint8_t x, uint8_t y, const char* text) {
    while (*text) { draw_char(x, y, *text); x += 6; text++; }
}
void oled_command(uint8_t cmd) {
    char d[2] = {0x00, (char)cmd};
    i2c.write(OLED_ADDR << 1, d, 2);
}
void update_display() {
    for (uint8_t p = 0; p < 4; p++) {
        oled_command(0xB0 + p); oled_command(0x00); oled_command(0x10);
        char d[129]; d[0] = 0x40;
        memcpy(d+1, &buffer[p*128], 128);
        i2c.write(OLED_ADDR << 1, d, 129);
    }
}
void init_oled() {
    oled_reset = 0; wait_us(1000);
    oled_reset = 1; wait_us(100000);
    const uint8_t cmds[] = {
        0xAE,0xD5,0x80,0xA8,0x1F,0xD3,0x00,0x40,
        0x8D,0x14,0x20,0x00,0xA1,0xC8,0xDA,0x02,
        0x81,0x8F,0xD9,0xF1,0xDB,0x40,0xA4,0xA6,0xAF
    };
    for (unsigned i = 0; i < sizeof(cmds); i++) oled_command(cmds[i]);
}
void clear_buffer() { memset(buffer, 0, 512); }
void draw_bar(uint8_t x, uint8_t y, uint8_t w, uint8_t h, float pct) {
    uint8_t f = (uint8_t)(w * pct / 100.0f);
    for (uint8_t i = x; i < x+w; i++) {
        if (y < 32) buffer[(y/8)*128+i] |= (1<<(y%8));
        if (y+h-1 < 32) buffer[((y+h-1)/8)*128+i] |= (1<<((y+h-1)%8));
    }
    for (uint8_t i = x; i < x+f && i < x+w; i++)
        for (uint8_t j = y+1; j < y+h-1; j++)
            if (j < 32) buffer[(j/8)*128+i] |= (1<<(j%8));
}

// ULTRASONIC 
float getDistanceCm() {
    trig = 0; wait_us(2);
    trig = 1; wait_us(10);
    trig = 0;
    int to = 30000;
    while (echo == 0 && to > 0) { wait_us(1); to--; }
    if (to <= 0) return -1.0f;
    Timer t; t.reset(); t.start();
    to = 30000;
    while (echo == 1 && to > 0) { wait_us(1); to--; }
    t.stop();
    if (to <= 0) return -1.0f;
    return t.read_us() / 58.0f;
}
float getAveragedDistance() {
    float sum = 0; int v = 0;
    for (int i = 0; i < NUM_SAMPLES; i++) {
        float d = getDistanceCm();
        if (d > 0 && d < 400) { sum += d; v++; }
        wait_us(30000);
    }
    return (v == 0) ? -1.0f : sum / v;
}
float distanceToLevel(float d) {
    if (d < 0) return -1.0f;
    if (d <= TANK_FULL_DIST_CM) return 100.0f;
    if (d >= TANK_EMPTY_DIST_CM) return 0.0f;
    return (TANK_EMPTY_DIST_CM - d) / (TANK_EMPTY_DIST_CM - TANK_FULL_DIST_CM) * 100.0f;
}

// MAIN 
int main() {
    i2c.frequency(I2C_FREQ);
    init_oled();
    clear_buffer();
    relay = 0;
    buzzer = 0;

    // Declare UART to ESP32 inside main
    Serial espUart(PA_9, PA_10);
    espUart.baud(9600);

    // Receive buffer for override commands
    char cmd[64];
    int cmd_idx = 0;

    bool full_buzzed = false;
    bool low_buzzed = false;
    draw_text(0, 0, "Water Monitor v2");
    draw_text(0, 12, "ESP32 connected");
    update_display();
    wait(2.0);

    while (1) {
        // READ SENSOR 
        float distance = getAveragedDistance();
        float level = distanceToLevel(distance);
        bool err = (level < 0);
        if (err) level = 0;

        // CHECK FOR OVERRIDE FROM ESP32 
        while (espUart.readable()) {
            char c = espUart.getc();
            if (c == '\n') {
                cmd[cmd_idx] = '\0';
                if (strncmp(cmd, "OVERRIDE:", 9) == 0) {
                    manual_override = (cmd[9] == '1');
                }
                cmd_idx = 0;
            } else if (cmd_idx < 62) {
                cmd[cmd_idx++] = c;
            }
        }

        // PUMP CONTROL 
        if (manual_override) {
            relay = 1;
        } else if (!err) {
            if (level < PUMP_ON_THRESHOLD) relay = 1;
            if (level >= PUMP_OFF_THRESHOLD) relay = 0;
        } else {
            relay = 0;
        }

        // BUZZER (single long beep on full/low) 
        if (!err) {
            if (level >= TANK_FULL_LEVEL && !full_buzzed) {
                buzzer = 1;
                wait(2.0);  // 2 second long beep
                buzzer = 0;
                full_buzzed = true;
            } else if (level < TANK_FULL_LEVEL) {
                full_buzzed = false;  // reset when level drops
            }
            
            if (level <= CRITICAL_LOW_LEVEL && !low_buzzed) {
                buzzer = 1;
                wait(2.0);  // 2 second long beep
                buzzer = 0;
                low_buzzed = true;
            } else if (level > CRITICAL_LOW_LEVEL) {
                low_buzzed = false;  // reset when level rises
            }
        } else {
            buzzer = (loop_count % 6 < 3);  // error pattern stays
        }

        // OLED 
        clear_buffer();
        char l1[22], l2[22], l3[22];
        sprintf(l1, "Level: %.1f%%", level);
        if (err) sprintf(l2, "SENSOR ERROR!");
        else if (level <= CRITICAL_LOW_LEVEL) sprintf(l2, "!! LOW !!");
        else if (level >= TANK_FULL_LEVEL) sprintf(l2, "** FULL **");
        else sprintf(l2, "D:%.1fcm", distance);

        if (manual_override)
            sprintf(l3, "Pump:ON [MANUAL]");
        else
            sprintf(l3, "Pump:%s [AUTO]", relay.read() ? "ON":"OFF");

        draw_text(0, 0, l1);
        draw_text(0, 10, l2);
        draw_text(0, 24, l3);
        draw_bar(90, 0, 36, 7, level);
        update_display();

        // SEND DATA TO ESP32 
        espUart.printf("L:%.1f,D:%.1f,P:%d\n", level, distance, relay.read());

        // TIMING 
        loop_count++;
        if (loop_count >= 1000) loop_count = 0;
        wait(0.5);
    }
}
